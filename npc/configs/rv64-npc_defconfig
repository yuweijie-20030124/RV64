## npc/configs/rv64-npc_defconfig
```kconfig
CONFIG_RV64=y
CONFIG_DEVICE=y
CONFIG_HAS_PORT_IO=y
CONFIG_HAS_SERIAL=y
CONFIG_SERIAL_PORT=0x3f8
CONFIG_SERIAL_MMIO=0xa0000000
CONFIG_HAS_TIMER=y
CONFIG_RTC_PORT=0x48
CONFIG_RTC_MMIO=0xa0000100
CONFIG_HAS_KEYBOARD=y
CONFIG_I8042_DATA_PORT=0x60
CONFIG_I8042_DATA_MMIO=0xa0000060
CONFIG_HAS_VGA=y
CONFIG_FB_ADDR=0xa1000000
CONFIG_VGA_CTL_PORT=0x100
CONFIG_VGA_CTL_MMIO=0xa0000100
CONFIG_VGA_SHOW_SCREEN=y
CONFIG_HAS_SBI_SERIAL=y
CONFIG_SBI_SERIAL_MMIO=0x10000000
CONFIG_HAS_SBI_DISK=y
CONFIG_SBI_DISK_MMIO=0x10100000
CONFIG_HAS_SBI_CLINT=y
CONFIG_SBI_CLINT_MMIO=0x2000000
CONFIG_HAS_SBI_PLIC=y
CONFIG_SBI_PLIC_MMIO=0xc000000
CONFIG_SBI_PLIC_CONTEXT_COUNT=2
CONFIG_RT_CHECK=y
CONFIG_USE_NVBOARD=y
```
